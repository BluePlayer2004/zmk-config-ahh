#include <behaviors.dtsi>
#include <dt-bindings/zmk/keys.h>
#include "keys_de.h"

/ {
    &studio_unlock
    // Define a default keymap here.
    // See https://zmk.dev/docs/development/hardware-integration/new-shield#default-keymap.
    keymap {
        compatible = "zmk,keymap";
        &studio_unlock
        default_layer {
            bindings = <
                &kp C_MUTE &kp ESC &kp F1 &kp F2 &kp F3 &kp F5 &kp F6 &kp F7 &kp F8 &kp F9 &kp F10 &kp F11 &kp F12 &kp PSCRN &kp SLCK &kp PAUSE_BREAK
                &kp F24 &kp DE_CARET &kp DE_N1 &kp DE_N2 &kp DE_N3 &kp DE_N4 &kp DE_N5 &kp DE_N6 &kp DE_N7 &kp DE_N8 &kp DE_N9 &kp DE_N0 &kp DE_SHARP_S &kp DE_ACUTE &kp BSPC &kp INS &kp HOME &kp PAGE_UP &kp LNLCK &kp / &kp * &kp -
                &kp F23 &kp TAB &kp DE_Q &kp DE_W &kp DE_E &kp DE_R &kp DE_T &kp DE_Z &kp DE_U &kp DE_I &kp DE_O &kp DE_p &kp DE_U_UMLAUT &kp DE_PLUS &kp ENTER &kp DEL &kp END &kp PG_DN &kp KP_NUMBER_7 &kp KP_NUMBER_8 &kp KP_NUMBER_9 &kp DE_PLUS
                &kp C_NEXT &kp CAPSLOCK &kp DE_A &kp DE_S &kp DE_D &kp DE_F &kp DE_G &kp DE_H &kp DE_J &kp DE_K &kp DE_L &kp DE_O_UMLAUT &kp DE_A_UMLAUT &kp DE_HASH &kp KP_NUMBER_4 &kp KP_NUMBER_5 &kp KP_NUMBER_6
                &kp C_PLAY_PAUSE &kp LSHIFT &kp DE_LESS_THAN &kp DE_Y &kp DE_X &kp DE_C &kp DE_V &kp DE_B &kp DE_N &kp DE_M &kp DE_COMMA &kp DE_PERIOD &kp DE_MINUS &kp RSHIFT &kp UP &kp KP_NUMBER_1 &kp KP_NUMBER_2 &kp KP_NUMBER_3 &kp ENTER
                &kp C_PREV &kp LCTRL &kp LWIN &kp LALT &kp SPACE &kp RALT &kp FN &kp RWIN &kp RCTRL &kp LEFT &kp DOWN &kp RIGHT &kp KP_NUMBER_0 &kp COMMA
        };
    };
};
